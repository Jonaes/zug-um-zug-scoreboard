/*
 * Zug um Zug Scoreboard
 * 
 * Autor: Jannis Raabe
 * Kontakt: jonaes02@gmx.de
 * 
 */

// LCD-Setup
#include <Wire.h>
#include <LiquidCrystal_I2C.h>
LiquidCrystal_I2C lcd(0x27, 20, 4);
byte ae[] = {
	B01010,
	B00000,
	B01110,
	B00001,
	B01111,
	B10001,
	B01111,
	B00000
};
//Keypad einrichten
#include <Keypad.h>

const byte COLS = 4;
const byte ROWS = 4;
char hexaKeys[ROWS][COLS] = {
	{'D', '#', '0', '*'},
	{'C', '9', '8', '7'},
	{'B', '6', '5', '4'},
	{'A', '3', '2', '1'}
};

byte colPins[COLS] = {2, 3, 4, 5};
byte rowPins[ROWS] = {6, 7, 8, 9};
char key;
Keypad pad = Keypad(makeKeymap(hexaKeys), rowPins, colPins, ROWS, COLS);
//GlobaleVariablen
String r = "55";
String ret = "";
int S = 0;
int W = 0;
int P = 0;

void setup() {
	//IR-Setup
	Serial.begin(9600);
	
	// LCD-Setup
	lcd.init();
	lcd.backlight();
	lcd.createChar(ae, ae);
	lcd.cursor();
	lcd.clear();
	lcd.setCursor(0, 0);
	lcd.print("Zug um Zug");
	lcd.setCursor(0, 1);
	lcd.print("Scoreboard");
	lcd.setCursor(0, 2);
	lcd.print("Anzahl der Spieler");
	lcd.setCursor(0, 3);
	
	//Eingabe und Anlage Spieler
	int aS = 55;
	int lZ[] = {0, 0, 0};
	lcd.print(">");
	do {
		aS = keyip();
	} while (aS > 5 || aS < 2);
	
	lcd.print(aS);
	int pS[aS + 1];
	for (int i = 1; i < aS + 1; i++) {
		pS[i] = 0;
	}
	  delay(1000);
	  hs(aS, pS, P, W, S);
	  delay(1000);
	  //Hauptmenü--Aktion ausführen
	  while (true) {
		  int act = 0;
		  act = keyip();
		  
		  Serial.println(act);
		  if (act > 0 && act < aS + 1) {
			  addPoints(act, pS);
		  }
		      else if (act == -6) {//*
				  undo(pS);
			  }
			      else if (act == -13) {//#
					  auswertung(aS, pS);
				  }
				      else {
						  lcd.setCursor(14, 0); lcd.print("Fehler");
						  delay(500);
						  lcd.setCursor(14, 0); lcd.print("      ");
					  }
					      hs(aS, pS, P, W, S);
	  }
	  
}

void loop() {
	
}

void addPoints(int act, int pS[]) {
	S = act;
	lcd.clear();
	lcd.setCursor(0, 0); lcd.print("Eingabe");
	lcd.setCursor(0, 1); lcd.print("Spieler: "); lcd.setCursor(9, 1); lcd.print(S);
	lcd.setCursor(0, 2); lcd.print("Anzahl Wagen: ");
	lcd.setCursor(0, 3); lcd.print("Punkte: "); lcd.setCursor(14, 2);
	
	
	W = keyip();
	while (W !=  1 && W !=  2 && W !=  3 && W !=  4 && W !=  6 && W != 8) {
		lcd.setCursor(14, 0); lcd.print("Fehler"); delay(500); lcd.setCursor(14, 0); lcd.print("      "); lcd.setCursor(14, 2);
		W = keyip();
	}
	  lcd.print(W);
	  
	  switch (W) {
		  case 1:
			  P = 1; break;
		  case 2:
			  P = 2; break;
		  case 3:
			  P = 4; break;
		  case 4:
			  P = 7; break;
		  case 6:
			  P = 15; break;
		  case 8:
			  P = 21; break;
		  default:
			  P = 0; break;
	  }
	    lcd.setCursor(8, 3); lcd.print(P);
		pS[S] += P;
		delay(500);
		
}

void hs(int aS, int pS[], int P, int W, int S) {
	lcd.clear();
	if (aS < 3) {
		lcd.setCursor(0, 0); lcd.print("Zug um Zug");
		lcd.setCursor(0, 1); lcd.print("Spieler 1"); lcd.setCursor(17, 1); lcd.print(pS[1]);
		lcd.setCursor(0, 2); lcd.print("Spieler 2"); lcd.setCursor(17, 2); lcd.print(pS[2]);
		lcd.setCursor(0, 3); lcd.print("> "); lcd.print(S); lcd.print(": "); lcd.print(W); lcd.print(" Wagen, +"); lcd.print(P);
		
	}
	  //TODO mehr Spieler handlen
	    if (aS == 3) {
			lcd.setCursor(0, 0); lcd.print("Spieler 1"); lcd.setCursor(17, 0); lcd.print(pS[1]);
			lcd.setCursor(0, 1); lcd.print("Spieler 2"); lcd.setCursor(17, 1); lcd.print(pS[2]);
			lcd.setCursor(0, 2); lcd.print("Spieler 3"); lcd.setCursor(17, 2); lcd.print(pS[3]);
			lcd.setCursor(0, 3); lcd.print("> "); lcd.print(S); lcd.print(": "); lcd.print(W); lcd.print(" Wagen, +"); lcd.print(P);
			
		}
		  if (aS < 6 && aS > 3) {
			  lcd.setCursor(0, 0); lcd.print("1: ");  lcd.print(pS[1]); lcd.setCursor(0, 7); lcd.print("|");
			  lcd.setCursor(0, 1); lcd.print("2: "); lcd.print(pS[2]); lcd.setCursor(1, 7); lcd.print("|");
			  lcd.setCursor(0, 2); lcd.print("3: ");  lcd.print(pS[3]); lcd.setCursor(2, 7); lcd.print("|");
			  lcd.setCursor(0, 3); lcd.print("> "); lcd.print(S); lcd.print(": "); lcd.print(W); lcd.print(" Wagen, +"); lcd.print(P);
			  for (int i = 4; i < aS + 1; i++) {
				  lcd.setCursor( 9, i - 4); lcd.print(i); lcd.print(": ");  lcd.print(pS[i]);
			  }
			       
		  }
}

void undo(int pS[]) {
	pS[S] -= P;
	lcd.setCursor(0, 3); lcd.print("                    ");
	lcd.setCursor(0, 3); lcd.print("> "); lcd.print(S); lcd.print(": "); lcd.print(" undo, -"); lcd.print(P);
	delay(1500);
}

void auswertung(int aS, int pS[]) {
	for (int i = 1; i < aS + 1; i++) {
		//Erfolgreiche Zielkarten
		lcd.clear();
		lcd.setCursor(0, 0); lcd.print("Spieler "); lcd.print(i);
		lcd.setCursor(0, 1); lcd.print("Erfolgr. Zielkarten:");
		lcd.setCursor(0, 2); lcd.print("xxx"); lcd.setCursor(0, 2);
		int act[3];
		for (int j = 0; j < 3; j++) {
			
			act[j] = keyip();
			lcd.print(act[j]);
		}
		    int addP = (act[0] * 100) + (act[1] * 10) + (act[2]);
			pS[i] += addP;
			delay(1000);
			//Fehlgeschl. Zielkarten
			lcd.clear();
			lcd.setCursor(0, 0); lcd.print("Spieler "); lcd.print(i);
			lcd.setCursor(0, 1); lcd.print("Fehlgeschlagene");
			lcd.setCursor(0, 2); lcd.print("Zielkarten:");
			lcd.setCursor(0, 3); lcd.print("xxx"); lcd.setCursor(0, 3);
			int act2[3];
			for (int j = 0; j < 3; j++) {
				
				act2[j] = keyip();
				lcd.print(act2[j]);
			}
			    int subP = (act2[0] * 100) + (act2[1] * 10) + (act2[2]);
				pS[i] -= subP;
				delay(1000);
	}
	  //Längste Strecke
	    lcd.clear();
		lcd.setCursor(0, 0); lcd.print("L\xE1ngste Strecke:");
		lcd.setCursor(0, 1); lcd.print("Spieler ");
		int p = 20;
		do {
			lcd.setCursor(8, 1);
			p = keyip();
			if (p < aS + 1 && p > 0) {
				break;
			}
			    lcd.setCursor(14, 0); lcd.print("Fehler");
				delay(500);
				lcd.setCursor(0, 0); lcd.print("L\xE1ngste Strecke     ");
		} while (p > aS || p < 1);
		
		lcd.print(p);
		pS[p] += 10;
		delay(1000);
		rangliste(pS, aS);
}

void rangliste(int pS[], int aS) {
	int erg[(aS + 1) * 2];
	int k;
	for (int i = 1; i < aS + 1; i++) { //In das Array werden zunächst die Ergebnisse eingefüllt, auf die Ergebnisse folgend die zugehörigen Spielernummern
		k = aS + i;
		erg[i] = pS[i];
		erg[k] = i;
	}
	
	  //BubbleSort
	    int j;
		for (int i = 1; i < (aS + 1 - 1); i++) {
			for (int o = 1; o < (aS + 1 - (i + 1)); o++) {
				if (erg[o] > erg[o + 1]) {
					j = aS + o;
					int help = erg[o];
					erg[o] = erg[o + 1];
					erg[o + 1] = help;
					help = erg[j];
					erg[j] = erg[j + 1];
					erg[j + 1] = help;
				}
			}
		}
		  //Ergebnisse auflisten
		    lcd.clear();
			int lastPlace;
			if (aS > 4) {
				lastPlace = 4;
			}
			  else {
				  lastPlace = aS;
			  }
			    int ln = lastPlace - 1;
				for (int pl = lastPlace; pl > 0; pl--) {
					k = aS + pl;
					lcd.setCursor(0, ln); lcd.print(pl); lcd.print(": Spieler "); lcd.print(erg[k]); lcd.setCursor(17, ln); lcd.print(erg[pl]);
					ln--;
					delay(500);
					
				}
				  int cont = keyip();
}


int keyip() {
	char help =  pad.waitForKey();
	int ausg = help - '0';
	  return ausg;
}

